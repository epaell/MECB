****************
* TSC SPACE VOYAGE
* FIXES FOR MC3
* DANIEL TUFVESSON 2013

* MC3 MONITOR ROUTINES
RETURN	EQU	$C000
OUTCHAR	EQU	$C003
INCHAR	EQU	$C006
PDATA	EQU	$C009
OUTHR	EQU	$C00C
OUTHL	EQU	$C00F

* JUMPTABLE
	ORG	$00E9
	JMP	PDATA
	JMP	OUTHR
	JMP	OUTHL
	JMP	OUTS
	JMP	OUTCHAR
	JMP	INCHAR
	JMP	RANDOM

* EXIT FIX
	ORG	$0B77
	JMP	RETURN

* STACK FIX
	ORG	$0100
	NOP
	NOP
	NOP

* BEGINNING OF ADDITIONAL ROUTINES
	ORG	$1000

* OUTS FIX
OUTS    LDAA    #$20    SPACE
OUTPUT	JMP     OUTCHAR

* RANDOM FIX
RANDOM	PSHB	RANDOM	NUMBER GENERATOR - SAVE B
	LDAA	STUF+1	COMPUTE (STUF * 2 * * 9) MOD 2 ** 16
	CLC
	ROLA
	CLC
	ROLA
	ADDA	STUF	ADD STUFF TO RESULT
	LDAB	STUF+1
	CLC		MULTIPLY BY 2 ** 2
	ROLB
	ROLA
	CLC
	ROLB
	ROLA
	CLC
	ADDB	STUF+1	ADD STUFF TO RESULT
	ADCA	STUF
	CLC
	ADDB	#$19	ADD HEXADECIMAL 3619 TO THE RESULT
	ADDA	#$36
	STAA	STUF	STORE RESULT IN STUF
	STAB	STUF+1
	PULB		RESTORE B
	RTS
STUF	RMB	4
