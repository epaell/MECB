*================================================
* FLEX.INC
*
* This file contains definitions of data for
* writing FLEX compatible programs.
*
* This sets the base address of FLEX.
*
* For 6800 this is A000.
* For 6809 this is C000.
*
FLEXBAS EQU     $C000
*
LINEBUF EQU     FLEXBAS+$80
FCB     EQU     FLEXBAS+$0840
DATE    EQU     FLEXBAS+$0C0E
LSTTRM  EQU     FLEXBAS+$0C11
LBPTR   EQU     FLEXBAS+$0C14
WARMS   EQU     FLEXBAS+$0D03
RENTER  EQU     FLEXBAS+$0D06
INCH    EQU     FLEXBAS+$0D09
INCH2   EQU     FLEXBAS+$0D0C
OUTCH   EQU     FLEXBAS+$0D0F
OUTCH2  EQU     FLEXBAS+$0D12
GETCHR  EQU     FLEXBAS+$0D15
PUTCHR  EQU     FLEXBAS+$0D18
INBUFF  EQU     FLEXBAS+$0D1B
PSTRNG  EQU     FLEXBAS+$0D1E
CLASS   EQU     FLEXBAS+$0D21
PCRLF   EQU     FLEXBAS+$0D24
NXTCH   EQU     FLEXBAS+$0D27
RSTRIO  EQU     FLEXBAS+$0D2A
GETFIL  EQU     FLEXBAS+$0D2D
LOAD    EQU     FLEXBAS+$0D30
SETEXT  EQU     FLEXBAS+$0D33
ADDBX   EQU     FLEXBAS+$0D36
OUTDEC  EQU     FLEXBAS+$0D39
OUTHEX  EQU     FLEXBAS+$0D3C
RPTERR  EQU     FLEXBAS+$0D3F
GETHEX  EQU     FLEXBAS+$0D42
OUTADR  EQU     FLEXBAS+$0D45
INDEC   EQU     FLEXBAS+$0D48
DOCMND  EQU     FLEXBAS+$0D4B
STAT    EQU     FLEXBAS+$0D4E
FMS     EQU     FLEXBAS+$1406
FMSCALL EQU     FMS
*
